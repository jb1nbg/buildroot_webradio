## package/caps/Config.in
```kconfig
config BR2_PACKAGE_CAPS
    bool "caps"
    depends on BR2_INSTALL_LIBSTDCPP
    help
      CAPS is a collection of audio plugins comprising virtual guitar
      amplification and a small range of basic classic effects, signal

      processors and generators of often elementary and occasionally
      exotic nature.

      The plugins aim to satisfy the highest demands in sound quality
      with maximal computational efficiency and zero latency.

      http://quitte.de/dsp/caps.html

comment "caps needs a toolchain w/ C++"
    depends on !BR2_INSTALL_LIBSTDCPP
```

## package/qtclicklabel/Config.in
```kconfig
config BR2_PACKAGE_QTCLICKLABEL
	bool "qtclicklabel"
	depends on BR2_PACKAGE_QT5BASE
	help
	  QLabel with added "clicked" Signal and text size limitation 
	  if the text is longer as the control width.
	  
	  This control has also a QDesigner plugin.
```

## package/qtwebradio/Config.in
```kconfig
config BR2_PACKAGE_QTWEBRADIO
	bool "qtwebradio"
	depends on BR2_PACKAGE_QT5BASE
	select BR2_PACKAGE_QTCLICKLABEL
	help
	  Qt5 based Webradio
```
